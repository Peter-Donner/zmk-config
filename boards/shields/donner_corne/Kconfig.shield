## boards/shields/donner_corne/Kconfig.shield
```kconfig
# Copyright (c) 2020 Pete Johanson
# SPDX-License-Identifier: MIT

config SHIELD_DONNER_CORNE_LEFT
    def_bool $(shields_list_contains,donner_corne_left)

config SHIELD_DONNER_CORNE_RIGHT
    def_bool $(shields_list_contains,donner_corne_right)
```
