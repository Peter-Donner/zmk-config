#include "donner_corne.dtsi"

&kscan0 {
    label = "KSCAN_LEFT";

    row-gpios = <&gpio0 20 (GPIO_ACTIVE_HIGH | GPIO_PULL_DOWN)>,
                <&gpio0 17 (GPIO_ACTIVE_HIGH | GPIO_PULL_DOWN)>,
                <&gpio1 4  (GPIO_ACTIVE_HIGH | GPIO_PULL_DOWN)>,
                <&gpio1 6  (GPIO_ACTIVE_HIGH | GPIO_PULL_DOWN)>;

    col-gpios = <&gpio1 0  GPIO_ACTIVE_HIGH>,
                <&gpio0 9  GPIO_ACTIVE_HIGH>,
                <&gpio0 22 GPIO_ACTIVE_HIGH>,
                <&gpio0 24 GPIO_ACTIVE_HIGH>,
                <&gpio0 11 GPIO_ACTIVE_HIGH>,
                <&gpio0 10 GPIO_ACTIVE_HIGH>;
};
