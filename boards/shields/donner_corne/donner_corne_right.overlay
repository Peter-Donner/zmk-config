/*
 * Copyright (c) 2020 Pete Johanson
 *
 * SPDX-License-Identifier: MIT
 */

#include "donner_corne.dtsi"

&default_transform {
    col-offset = <6>;
};

&five_column_transform {
    col-offset = <6>;
};

&kscan0 {
    row-gpios = <&gpio1 0 (GPIO_ACTIVE_HIGH | GPIO_PULL_DOWN)>,
                <&gpio0 11 (GPIO_ACTIVE_HIGH | GPIO_PULL_DOWN)>,
                <&gpio1 4  (GPIO_ACTIVE_HIGH | GPIO_PULL_DOWN)>,
                <&gpio1 6  (GPIO_ACTIVE_HIGH | GPIO_PULL_DOWN)>;

    col-gpios = <&gpio0 2  GPIO_ACTIVE_HIGH>,
                <&gpio1 15  GPIO_ACTIVE_HIGH>,
                <&gpio1 13 GPIO_ACTIVE_HIGH>,
                <&gpio1 11 GPIO_ACTIVE_HIGH>,
                <&gpio0 10 GPIO_ACTIVE_HIGH>,
                <&gpio0 9 GPIO_ACTIVE_HIGH>;
};
